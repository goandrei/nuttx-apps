## netutils/ngtcp2/Kconfig
```kconfig
#
# For a description of the syntax of this configuration file,
# see the file kconfig-language.txt in the NuttX tools repository.
#

config NETUTILS_NGTCP2
	bool "QUIC - ngtcp2 library"
	default n
	depends on CRYPTO_WOLFSSL
	depends on LIBUV
	---help---
		ngtcp2 is a C implementation of QUIC protocol based on RFC9000.

if NETUTILS_NGTCP2

config NETUTILS_NGTCP2_VERSION
	string "QUIC - ngtcp2 version"
	default "1.21.0"

config NETUTILS_NGTCP2_CLIENT
	bool "Build ngtcp2 QUIC client example"
	default n
	depends on NETUTILS_NGTCP2
	---help---
		Build the ngtcp2 QUIC client example.

config NETUTILS_NGTCP2_SERVER
	bool "Build ngtcp2 QUIC server example"
	default n
	depends on NETUTILS_NGTCP2
	---help---
		Build the ngtcp2 QUIC server example.

if NETUTILS_NGTCP2_CLIENT || NETUTILS_NGTCP2_SERVER

config NETUTILS_NGTCP2_EXAMPLE_PRIORITY
	int "ngtcp2 example priority"
	default 100

config NETUTILS_NGTCP2_EXAMPLE_STACKSIZE
	int "ngtcp2 example stacksize"
	default 2048

endif # NETUTILS_NGTCP2_CLIENT || NETUTILS_NGTCP2_SERVER

endif # NETUTILS_NGTCP2
```
